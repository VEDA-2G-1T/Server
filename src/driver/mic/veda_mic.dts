/dts-v1/;
/plugin/;
/ {
    compatible = "brcm,bcm2835";
    fragment@0 {
        target = <&i2c1>;
        __overlay__ {
            #address-cells = <1>;
            #size-cells = <0>;
            status = "okay";
            veda_mic@48 {
                compatible = "veda_1,veda_mic";
                reg = <0x48>;
                status = "okay";
            };
        };
    };
};






